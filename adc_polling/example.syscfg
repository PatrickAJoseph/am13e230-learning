/**
 *
 * @cliArgs --device "AM13E230x" --part "AM13E230x" --package "LQFP64_G" --product "AM13E2X SDK@26.01.00"
 * @versions {"tool":"1.28.0+4696"}
 */

/**
 * Import the modules used in this configuration.
 */
const adc        = scripting.addModule("/drivers/adc", {}, false);
const adc1       = adc.addInstance();
const cmpsslite  = scripting.addModule("/drivers/cmpsslite", {}, false);
const cmpsslite1 = cmpsslite.addInstance();
const config     = scripting.addModule("/drivers/config");
const gpio       = scripting.addModule("/drivers/gpio", {}, false);
const gpio1      = gpio.addInstance();
const sysctl     = scripting.addModule("/drivers/sysctl");

/**
 * Write custom configuration values to the imported modules.
 */
adc1.$name             = "APP_ADC_0";
adc1.numberOfSOCs      = 1;
adc1.enableSEQs        = true;
adc1.numberOfSEQs      = 1;
adc1.adcClockPrescaler = "DL_ADC_CLOCK_DIVIDE_8_0";
adc1.SOC0.channel      = "PA16";

cmpsslite1.$name                  = "APP_CMPSSLITE_0";
cmpsslite1.cmpssliteBase          = "CMPSS2";
cmpsslite1.lowDAC.enableDACOUT    = true;
cmpsslite1.lowDAC.initialDacValue = 1000;

gpio1.$name                         = "GPIO_GRP_0";
gpio1.associatedPins[0].$name       = "PIN_0";
gpio1.associatedPins[0].pin.$assign = "PA5";

sysctl.useHFCLK     = true;
sysctl.SYSPLLSource = "DL_SYSCTL_SYSPLL_REF_HFCLK";
sysctl.SYSPLL_Qdiv  = 32;
sysctl.VREFSource   = "DL_SYSCTL_VREF_INTERNAL_3_3_V";

/**
 * Pinmux solution for unlocked pins/peripherals. This ensures that minor changes to the automatic solver in a future
 * version of the tool will not impact the pinmux you originally saw.  These lines can be completely deleted in order to
 * re-solve from scratch.
 */
adc1.SOC0.peripheral.$suggestSolution               = "ANALOG";
adc1.SOC0.peripheral.AIN16.$suggestSolution         = "PA16";
cmpsslite1.lowDAC.peripheral.$suggestSolution       = "ANALOG";
cmpsslite1.lowDAC.peripheral.AIN10.$suggestSolution = "PA4";
sysctl.peripheral.$suggestSolution                  = "SYSCTL";
sysctl.peripheral.x1Pin.$suggestSolution            = "PC16_X1";
sysctl.peripheral.x2Pin.$suggestSolution            = "PC17_X2";
