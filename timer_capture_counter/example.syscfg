/**
 *
 * @cliArgs --device "AM13E230x" --part "AM13E230x" --package "LQFP64_G" --product "AM13E2X SDK@26.01.00"
 * @versions {"tool":"1.28.0+4696"}
 */

/**
 * Import the modules used in this configuration.
 */
const config = scripting.addModule("/drivers/config");
const gpio   = scripting.addModule("/drivers/gpio", {}, false);
const gpio1  = gpio.addInstance();
const timer  = scripting.addModule("/drivers/timer", {}, false);
const timer1 = timer.addInstance();

/**
 * Write custom configuration values to the imported modules.
 */
gpio1.$name                         = "GPIO_GRP_0";
gpio1.associatedPins[0].$name       = "PIN_0";
gpio1.associatedPins[0].pin.$assign = "PA5";

const sysctl        = scripting.addModule("/drivers/sysctl", {}, false);
sysctl.useHFCLK     = true;
sysctl.SYSPLLSource = "DL_SYSCTL_SYSPLL_REF_HFCLK";
sysctl.SYSPLL_Qdiv  = 32;

timer1.$name            = "APP_TIMER_0";
timer1.timerMode        = "DL_TIMER_TIMER_MODE_PERIODIC_UP";
timer1.timerPeriod      = "1 ms";
timer1.timerStartTimer  = true;
timer1.timerClkPrescale = 100;
timer1.interrupts       = ["DL_TIMER_INTERRUPT_ZERO_EVENT"];

/**
 * Pinmux solution for unlocked pins/peripherals. This ensures that minor changes to the automatic solver in a future
 * version of the tool will not impact the pinmux you originally saw.  These lines can be completely deleted in order to
 * re-solve from scratch.
 */
sysctl.peripheral.$suggestSolution       = "SYSCTL";
sysctl.peripheral.x1Pin.$suggestSolution = "PC16_X1";
sysctl.peripheral.x2Pin.$suggestSolution = "PC17_X2";
timer1.peripheral.$suggestSolution       = "TIMG4_0";
